// SPDX-License-Identifier: (GPL-2.0+ OR MIT)
/*
 * Copyright (c) 2023 Edgeble AI Technologies Pvt. Ltd.
 */

/dts-v1/;
/plugin/;

&{/} {
	model = "Edgeble NCM6B-CAM0-CAM1";
	compatible = "edgeble,neural-compute-module-6b-io", "rockchip,rk3588";
};

